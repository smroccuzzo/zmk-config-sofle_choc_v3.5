/ {
    /* Explicitly map the left encoder to its true hardware home */
    encoder_left: encoder_left {
        compatible = "alps,ec11";
        a-gpios = <&pro_micro 21 (GPIO_ACTIVE_HIGH | GPIO_PULL_UP)>;
        b-gpios = <&pro_micro 20 (GPIO_ACTIVE_HIGH | GPIO_PULL_UP)>;
        steps = <80>;
        status = "okay";
    };

    /* Explicitly map the right encoder to its true hardware home */
    encoder_right: encoder_right {
        compatible = "alps,ec11";
        a-gpios = <&pro_micro 21 (GPIO_ACTIVE_HIGH | GPIO_PULL_UP)>;
        b-gpios = <&pro_micro 20 (GPIO_ACTIVE_HIGH | GPIO_PULL_UP)>;
        steps = <80>;
        status = "okay";
    };

    /* Ensure ZMK cleanly chains them 0 (Left), 1 (Right) */
    sensors: sensors {
        compatible = "zmk,keymap-sensors";
        sensors = <&encoder_left &encoder_right>;
        triggers-per-rotation = <20>;
    };
};
